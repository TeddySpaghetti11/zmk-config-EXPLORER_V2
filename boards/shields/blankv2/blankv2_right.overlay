// This file was generated from a template. Edit it to match your keyboard.
// See https://zmk.dev/docs/development/hardware-integration/new-shield for more
// instructions.

#include "blankv2.dtsi"

&default_transform {
    // Set this to the number of columns on the left side.
    col-offset = <2>;
};

&kscan {
    row-gpios = <&gpiod 4 GPIO_ACTIVE_HIGH>, <&gpioc 6 GPIO_ACTIVE_HIGH>, <&gpiod 7 GPIO_ACTIVE_HIGH>, <&gpioe 6 GPIO_ACTIVE_HIGH>, <&gpiob 4 GPIO_ACTIVE_HIGH>;
    col-gpios = <&gpiob 5 GPIO_ACTIVE_HIGH>, <&gpiob 6 GPIO_ACTIVE_HIGH>, <&gpiob 2 GPIO_ACTIVE_HIGH>, <&gpiob 3 GPIO_ACTIVE_HIGH>, <&gpiob 1 GPIO_ACTIVE_HIGH>, <&gpiof 7 GPIO_ACTIVE_HIGH>;
};
