// This file was generated from a template. Edit it to match your keyboard.
// See https://zmk.dev/docs/development/hardware-integration/new-shield for more
// instructions.

#include "blankv2.dtsi"

&kscan {
    row-gpios = <&gpio0 6 GPIO_ACTIVE_LOW>,
                <&gpio0 8 GPIO_ACTIVE_LOW>,
                <&gpio0 17 GPIO_ACTIVE_LOW>,
                <&gpio0 20 GPIO_ACTIVE_LOW>,
                <&gpio0 25 GPIO_ACTIVE_LOW>;

    col-gpios = <&gpio0 24 GPIO_ACTIVE_LOW>,
                <&gpio1 0 GPIO_ACTIVE_LOW>,
                <&gpio0 11 GPIO_ACTIVE_LOW>,
                <&gpio1 6 GPIO_ACTIVE_LOW>,
                <&gpio0 31 GPIO_ACTIVE_LOW>,
                <&gpio0 28 GPIO_ACTIVE_LOW>;
};

